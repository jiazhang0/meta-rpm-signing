## conf/layer.conf
```bitbake
#
# Copyright (C) 2017 Wind River Systems, Inc.
#

# We have a conf and classes directory, add to BBPATH
BBPATH =. "${LAYERDIR}:"

# We have a packages directory, add to BBFILES
BBFILES += "${LAYERDIR}/recipes-*/*/*.bb \
        ${LAYERDIR}/recipes-*/*/*.bbappend"

BBFILE_COLLECTIONS += "meta-rpm-signing"
BBFILE_PATTERN_meta-rpm-signing = "^${LAYERDIR}/"
BBFILE_PRIORITY_meta-rpm-signing = "7"

# This should only be incremented on significant changes that will
# cause compatibility issues with other layers
LAYERVERSION_meta-rpm-signing = "1"

INHERIT += "sign_rpm"

# Set digest to sha256, this is for files
# checkout it via 'rpm -qp --dump <pkg_name>'
RPM_FILE_DIGEST_ALGO = "8"

# Set non-repudiable signature to RSA/SHA256
RPM_SELF_SIGN_ALGO = "RSA/SHA256"

# Set GPG digest for header signature
# checkout it via 'rpm -Kv <pkg_name>'
RPM_GPG_DIGEST_ALGO = "sha256"
```
